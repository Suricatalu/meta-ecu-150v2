## conf/layer.conf
```bitbake
BBPATH .= ":${LAYERDIR}"
BBFILES += "${LAYERDIR}/recipes-*/*/*.bb ${LAYERDIR}/recipes-*/*/*.bbappend"
BBFILE_COLLECTIONS += "meta-ecu150v2"
BBFILE_PATTERN_meta-ecu150v2 = "^${LAYERDIR}/"
BBFILE_PRIORITY_meta-ecu150v2 = "10"
LAYERSERIES_COMPAT_meta-ecu150v2 = "walnascar"

# Add kernel-devsrc to the image
IMAGE_INSTALL:append = " kernel-devsrc"
```
